## Kconfig
```kconfig
# Generate Easykey
menu "BSP Key Config"

config LONG_PRESS_TIME
    int "key long press time (tick)"
    default 600

config KEY_DEBUG
    bool 
    default y
    prompt "按键的调试信息"

config TICKS_INTERVAL
    int 
    default 10
    prompt "按键扫描的时间间隔，单位：ms"

config USE_FREERTOS
    bool
    default y
    prompt "使用FreeRTOS实现按键扫描"

config DOUBLE_CLICK_TIME
    int
    default 600
    prompt "双击的阈值，在这个时间内连续按下按键则会触发双击"

config FIFO_BUFFER_SIZE
    int 
    default 10
    prompt "FIFO的队列长度"

config FREE_RTOS_QUEUE
    bool  
    default n
    depends on USE_FREERTOS
    prompt "使用FreeRTOS的队列实现按键事件传输"

config DYNAMIC_ALLOCATION
    bool
    default n
    prompt "使用动态内存申请，如果不使用FreeRTOS的API，请在Easykey.h中的宏替换自己的API"
endmenu
```
